#include "amc.h"
#include "app.h"
#include "Com2Server.h"
#include "FreeRTOS.h"
#include "task.h"
u16 crcTable[256] = 
{
	0x0000,0x1021,0x2042,0x3063,0x4084,0x50A5,0x60C6,0x70E7,
	0x8108,0x9129,0xA14A,0xB16B,0xC18C,0xD1AD,0xE1CE,0xF1EF,
	0x1231,0x0210,0x3273,0x2252,0x52B5,0x4294,0x72F7,0x62D6,
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	0x6E17,0x7E36,0x4E55,0x5E74,0x2E93,0x3EB2,0x0ED1,0x1EF0
};
void crccheck(u8 data, u16 *accumulator, u16 *crctable)
{
	*accumulator = ( *accumulator << 8 ) ^ crctable[( *accumulator >> 8) ^ data];
}
u16 crcCal(u8 *data,u16 length)
{
	u8 i = 0;
	u16 accumalator[1];
	accumalator[0] = 0;
	for(i = 0;i<length;i++)
	{
		crccheck(data[i],accumalator,crcTable);
	}
	return *accumalator;
}


/**
  * @brief  vChassisTask,只有速度和角度，或位置
  * @param  None
  * @retval None
  */
motion_target amc_motion_target;
extern float dir_angle_wheel[2];
extern u8 read_amc_over_flag;
int32_t speed = 0;
u8 time_out = 0;
extern u8 rotating_flag;
extern int32_t rotating_speed;
void vAmcMotionTask( void *p_arg )
{
	
    (void)p_arg;
	//amc_motion_target.wheel_angle = 45;
    while(1)
    {
        if(amc_motion_target.wheel_angle - dir_angle_wheel[0]>0.5f)
		{
			DMA_SendCommand(MOTOR_DIR_1,0x02,0x45,0x00,0x02,-2500);
		}
		else if(amc_motion_target.wheel_angle - dir_angle_wheel[0]<-0.5f)
		{
			DMA_SendCommand(MOTOR_DIR_1,0x02,0x45,0x00,0x02,2500);
		}
		else
		{
			DMA_SendCommand(MOTOR_DIR_1,0x02,0x45,0x00,0x02,0);
		}
		vTaskDelay(10*portTICK_MS);
		if(amc_motion_target.wheel_angle - dir_angle_wheel[1]>0.5f)
		{
			DMA_SendCommand(MOTOR_DIR_2,0x02,0x45,0x00,0x02,-2500);
		}
		else if(amc_motion_target.wheel_angle - dir_angle_wheel[1]<-0.5f)
		{
			DMA_SendCommand(MOTOR_DIR_2,0x02,0x45,0x00,0x02,2500);
		}
		else
		{
			DMA_SendCommand(MOTOR_DIR_2,0x02,0x45,0x00,0x02,0);
		}
		vTaskDelay(10*portTICK_MS);
		//speed = 10000;
		if(rotating_flag == 1)
		{
			DMA_SendCommand(MOTOR_MARCH_1,0x02,0x45,0x00,0x02,rotating_speed);//发送速度
			vTaskDelay(10*portTICK_MS);
			DMA_SendCommand(MOTOR_MARCH_2,0x02,0x45,0x00,0x02,rotating_speed);//发送速度
			vTaskDelay(10*portTICK_MS);
		}
		else
		{
			if(((dir_angle_wheel[0] - dir_angle_wheel[1])> -4) &&((dir_angle_wheel[0] - dir_angle_wheel[1])< 4))
			{
				DMA_SendCommand(MOTOR_MARCH_1,0x02,0x45,0x00,0x02,speed);//发送速度
				vTaskDelay(10*portTICK_MS);
				DMA_SendCommand(MOTOR_MARCH_2,0x02,0x45,0x00,0x02,-speed);//发送速度
				vTaskDelay(10*portTICK_MS);
			}
			else
			{
				DMA_SendCommand(MOTOR_MARCH_1,0x02,0x45,0x00,0x02,0);//发送速度
				vTaskDelay(10*portTICK_MS);
				DMA_SendCommand(MOTOR_MARCH_2,0x02,0x45,0x00,0x02,0);//发送速度
				vTaskDelay(10*portTICK_MS);
			}
		}
		
		
		
		read_amc_over_flag = 0;
		time_out= 0;
		while(read_amc_over_flag == 0)
		{	
			time_out++;
			if(time_out>= 3)
			{
				time_out = 0;
				break;
			}
				
			
			DMA_GetPos(MOTOR_DIR_1);
			vTaskDelay(6*portTICK_MS);
		}
		
		read_amc_over_flag = 0;
		time_out = 0;
		while(read_amc_over_flag == 0)
		{
			time_out++;
			if(time_out>= 3)
			{
				time_out = 0;
				break;
			}
			DMA_GetPos(MOTOR_DIR_2);
			vTaskDelay(6*portTICK_MS);
		}
    }
}
void vAmcPosTask( void *p_arg )
{
	
    (void)p_arg;
	vTaskDelay(5*portTICK_MS);
    while(1)
    {
		
        DMA_GetPos(MOTOR_DIR_1);
		vTaskDelay(20*portTICK_MS);
		DMA_GetPos(MOTOR_DIR_2);
		vTaskDelay(20*portTICK_MS);
        //  DMA_SendCommand(MOTOR_MARCH_1,0x02,0x07,0x00,0x01,0x0f);//get the write access
		//	vTaskDelay(5*portTICK_MS);
		//	DMA_SendCommand(MOTOR_MARCH_1,0x02,0x01,0x00,0x01,0x00);//enable the bridge
		//	vTaskDelay(5*portTICK_MS);
		//	DMA_SendCommand(MOTOR_MARCH_2,0x02,0x07,0x00,0x01,0x0f);//get the write access
		//	vTaskDelay(5*portTICK_MS);
		//	DMA_SendCommand(MOTOR_MARCH_2,0x02,0x01,0x00,0x01,0x00);//enable the bridge
		//	vTaskDelay(5*portTICK_MS);
		//	DMA_SendCommand(MOTOR_DIR_1,0x02,0x07,0x00,0x01,0x0f);//get the write access
		//	vTaskDelay(5*portTICK_MS);
		//	DMA_SendCommand(MOTOR_DIR_1,0x02,0x01,0x00,0x01,0x00);//enable the bridge
		//	vTaskDelay(5*portTICK_MS);
		//	DMA_SendCommand(MOTOR_DIR_2,0x02,0x07,0x00,0x01,0x0f);//get the write access
		//	vTaskDelay(5*portTICK_MS);
		//	DMA_SendCommand(MOTOR_DIR_2,0x02,0x01,0x00,0x01,0x00);//enable the bridge
		//	vTaskDelay(5*portTICK_MS);
		//DMA_SendCommand(MOTOR_MARCH_1,0x02,0x45,0x00,0x02,873.813*amc_motion_target.apeed);//发送速度
		
    }
}

















